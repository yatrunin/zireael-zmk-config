## config/boards/arm/dao/Kconfig.board
```kconfig
# Dao board configuration

# Copyright (c) 2021 Rafael Yumagulov
# SPDX-License-Identifier: MIT

config BOARD_DAO_LEFT
	bool "zireael_left"
	depends on SOC_NRF52840_QIAA

config BOARD_DAO_RIGHT
	bool "zireael_right"
	depends on SOC_NRF52840_QIAA
```
